## zephyr/drivers/Kconfig
```kconfig
# Copyright (c) 2026 Bert Outtier <outtierbert@gmail.com>
# SPDX-License-Identifier: Apache-2.0

rsource "mfd/Kconfig"
rsource "gpio/Kconfig"
rsource "input/Kconfig"
rsource "led/Kconfig"
rsource "sensor/Kconfig"
rsource "charger/Kconfig"
```

## zephyr/drivers/charger/Kconfig
```kconfig
# Copyright (c) 2026 Bert Outtier <outtierbert@gmail.com>
# SPDX-License-Identifier: Apache-2.0

if CHARGER

config CHARGER_FRI3D_EXPANDER
	bool "Fri3d Badge 2026 I/O coprocessor charger status"
	default y
	depends on DT_HAS_FRI3D_BADGE_2026_EXPANDER_CHARGER_ENABLED
	depends on MULTITHREADING # the MFD uses a mutex, work items and sleeps
	select MFD
	help
	  TP4056 charger status of the Fri3d Camp 2026 badge, read by its I/O
	  coprocessor.

endif # CHARGER
```

## zephyr/drivers/gpio/Kconfig
```kconfig
# Copyright (c) 2026 Bert Outtier <outtierbert@gmail.com>
# SPDX-License-Identifier: Apache-2.0

if GPIO

config GPIO_FRI3D_EXPANDER
	bool "Fri3d Badge 2026 I/O coprocessor GPIO driver"
	default y
	depends on DT_HAS_FRI3D_BADGE_2026_EXPANDER_GPIO_ENABLED
	depends on MULTITHREADING # the MFD uses a mutex, work items and sleeps
	select MFD
	help
	  Output-only GPIOs of the Fri3d Camp 2026 badge I/O coprocessor
	  (AUX 3V3 rail, LCD reset, LoRa reset).

config GPIO_FRI3D_EXPANDER_INIT_PRIORITY
	int "Initialization priority"
	default 71
	depends on GPIO_FRI3D_EXPANDER
	help
	  Must be after the expander MFD and before the MIPI DBI driver and
	  the aux_3v3 power domain.

endif # GPIO
```

## zephyr/drivers/input/Kconfig
```kconfig
# Copyright (c) 2026 Bert Outtier <outtierbert@gmail.com>
# SPDX-License-Identifier: Apache-2.0

if INPUT

config INPUT_FRI3D_EXPANDER
	bool "Fri3d Badge 2026 I/O coprocessor keys"
	default y
	depends on DT_HAS_FRI3D_BADGE_2026_EXPANDER_KEYS_ENABLED
	depends on MULTITHREADING # the MFD uses a mutex, work items and sleeps
	select MFD
	help
	  Buttons and joystick directions of the Fri3d Camp 2026 badge, read
	  by its I/O coprocessor.

config INPUT_FRI3D_EXPANDER_INIT_PRIORITY
	int "Initialization priority"
	default INPUT_INIT_PRIORITY
	depends on INPUT_FRI3D_EXPANDER

endif # INPUT
```

## zephyr/drivers/led/Kconfig
```kconfig
# Copyright (c) 2026 Bert Outtier <outtierbert@gmail.com>
# SPDX-License-Identifier: Apache-2.0

if LED

config LED_FRI3D_EXPANDER
	bool "Fri3d Badge 2026 I/O coprocessor LEDs"
	default y
	depends on DT_HAS_FRI3D_BADGE_2026_EXPANDER_LED_ENABLED
	depends on MULTITHREADING # the MFD uses a mutex, work items and sleeps
	select MFD
	help
	  LCD backlight and debug LED of the Fri3d Camp 2026 badge, driven by
	  its I/O coprocessor.

config LED_FRI3D_EXPANDER_INIT_PRIORITY
	int "Initialization priority"
	default LED_INIT_PRIORITY
	depends on LED_FRI3D_EXPANDER

endif # LED
```

## zephyr/drivers/mfd/Kconfig
```kconfig
# Copyright (c) 2026 Bert Outtier <outtierbert@gmail.com>
# SPDX-License-Identifier: Apache-2.0

if MFD

config MFD_FRI3D_EXPANDER
	bool "Fri3d Badge 2026 I/O coprocessor"
	default y
	depends on DT_HAS_FRI3D_BADGE_2026_EXPANDER_ENABLED
	depends on MULTITHREADING # the MFD uses a mutex, work items and sleeps
	select I2C
	help
	  Multi-function device driver for the CH32X035 I/O coprocessor of the
	  Fri3d Camp 2026 badge.

if MFD_FRI3D_EXPANDER

config MFD_FRI3D_EXPANDER_INIT_PRIORITY
	int "Initialization priority"
	default 70
	help
	  Must be after the I2C controller and before the MIPI DBI driver,
	  which uses the LCD reset of the GPIO child.

config MFD_FRI3D_EXPANDER_POLL
	bool "Poll the inputs instead of using the INT line"
	help
	  Read the input register periodically instead of when the
	  coprocessor pulses its INT line.

config MFD_FRI3D_EXPANDER_POLL_PERIOD_MS
	int "Input polling period in milliseconds"
	default 50
	depends on MFD_FRI3D_EXPANDER_POLL

config MFD_FRI3D_EXPANDER_SHELL
	bool "Coprocessor shell commands"
	default y
	depends on SHELL
	help
	  The "expander" shell command: firmware version, and with a bundled
	  image (MFD_FRI3D_EXPANDER_FIRMWARE) its installation.

config MFD_FRI3D_EXPANDER_UPDATE
	bool "Coprocessor firmware update over RVSWD"
	help
	  Update the coprocessor firmware with mfd_fri3d_expander_update(),
	  through the RVSWD interface of the expander's rvswd property: the
	  coprocessor remaps its I2C pins to SWD on request. Needs the
	  zephyr-rvswd module (github.com/bertouttier/zephyr-rvswd) in the
	  west workspace and an enabled wch,rvswd node as the expander's
	  rvswd property; the build stops if either is missing.

if MFD_FRI3D_EXPANDER_UPDATE

config MFD_FRI3D_EXPANDER_FIRMWARE
	string "Coprocessor firmware image to bundle"
	help
	  Path to a coprocessor firmware binary (badge_2026_fw release build),
	  absolute or relative to the application directory, to link into the
	  application. Empty: no image. With an image, the "expander update"
	  shell command installs it.

config MFD_FRI3D_EXPANDER_FIRMWARE_VERSION
	string "Version of the bundled firmware image"
	default "0.0.0"
	help
	  Version of the image in MFD_FRI3D_EXPANDER_FIRMWARE, as major.minor.patch.
	  Applications compare it with the coprocessor's version
	  (mfd_fri3d_expander_get_bundled_version()) to decide on an update; it
	  must match the image.

endif # MFD_FRI3D_EXPANDER_UPDATE

endif # MFD_FRI3D_EXPANDER

endif # MFD
```

## zephyr/drivers/sensor/Kconfig
```kconfig
# Copyright (c) 2026 Bert Outtier <outtierbert@gmail.com>
# SPDX-License-Identifier: Apache-2.0

if SENSOR

config FRI3D_EXPANDER_BATTERY
	bool "Fri3d Badge 2026 I/O coprocessor battery voltage"
	default y
	depends on DT_HAS_FRI3D_BADGE_2026_EXPANDER_SENSOR_ENABLED
	depends on MULTITHREADING # the MFD uses a mutex, work items and sleeps
	select MFD
	help
	  Battery voltage of the Fri3d Camp 2026 badge, measured by its I/O
	  coprocessor.

endif # SENSOR
```

## zephyr/dts/bindings/charger/fri3d,badge-2026-expander-charger.yaml
```yaml
# Copyright (c) 2026 Bert Outtier <outtierbert@gmail.com>
# SPDX-License-Identifier: Apache-2.0

description: |
  TP4056 battery charger status as reported by the Fri3d Badge 2026 IO
  expander, exposed through the charger API (read-only):

  - CHARGER_PROP_ONLINE: USB power present
  - CHARGER_PROP_STATUS: charging (CHRG), full (STDBY), not charging or
    discharging (on battery)

compatible: "fri3d,badge-2026-expander-charger"

include: base.yaml
```

## zephyr/dts/bindings/gpio/fri3d,badge-2026-expander-gpio.yaml
```yaml
# Copyright (c) 2026 Bert Outtier <outtierbert@gmail.com>
# SPDX-License-Identifier: Apache-2.0

description: |
  Output-only GPIO controller of the Fri3d Badge 2026 IO expander. Pin N is
  bit N of the expander output register (0x16), the level is the level of
  the coprocessor pin:

    0: AUX 3V3 rail enable (high = on)
    1: LCD and touch reset (low = in reset, use GPIO_ACTIVE_LOW)
    4: LoRa module reset (low = in reset, use GPIO_ACTIVE_LOW)

  Pins 2 (reboot coprocessor to bootloader) and 3 (remap I2C to SWD) are
  commands, not GPIOs, and are rejected.

compatible: "fri3d,badge-2026-expander-gpio"

include: gpio-controller.yaml

properties:
  "#gpio-cells":
    const: 2

gpio-cells:
  - pin
  - flags
```

## zephyr/dts/bindings/input/fri3d,badge-2026-expander-keys.yaml
```yaml
# Copyright (c) 2026 Bert Outtier <outtierbert@gmail.com>
# SPDX-License-Identifier: Apache-2.0

description: |
  Buttons and joystick directions of the Fri3d Camp 2026 badge, read by its
  I/O coprocessor. Each child node maps a bit of the coprocessor input
  register to an input event code.

compatible: "fri3d,badge-2026-expander-keys"

include: base.yaml

child-binding:
  description: Key
  properties:
    bit-num:
      type: int
      required: true
      description: Bit of the input register (0x04)

    label:
      type: string
      description: Descriptive name of the key

    zephyr,code:
      type: int
      required: true
      description: Key code to emit.
```

## zephyr/dts/bindings/led/fri3d,badge-2026-expander-led.yaml
```yaml
# Copyright (c) 2026 Bert Outtier <outtierbert@gmail.com>
# SPDX-License-Identifier: Apache-2.0

description: |
  PWM outputs of the Fri3d Badge 2026 IO expander, exposed through the LED
  API with brightness 0-100. LED 0 is the LCD backlight, LED 1 is the debug
  LED on the back of the badge.

  The LEDs can be described as child nodes in that order (led_dt_spec):

    leds {
        compatible = "fri3d,badge-2026-expander-led";

        backlight {
            label = "LCD backlight";
        };

        debug_led: debug-led {
            label = "Debug LED";
        };
    };

compatible: "fri3d,badge-2026-expander-led"

include: [base.yaml, led-controller.yaml]
```

## zephyr/dts/bindings/mfd/fri3d,badge-2026-expander.yaml
```yaml
# Copyright (c) 2026 Bert Outtier <outtierbert@gmail.com>
# SPDX-License-Identifier: Apache-2.0

description: |
  CH32X035 I/O coprocessor of the Fri3d Camp 2026 badge, running the
  badge_2026_fw firmware as an I2C slave (address 0x50).

  It reads the buttons, joystick, charger status, battery, USB and
  multimeter voltages, and controls the LCD backlight, debug LED, AUX 3V3
  rail, LCD reset and LoRa reset. The functions are child nodes:

    expander: expander@50 {
        compatible = "fri3d,badge-2026-expander";
        reg = <0x50>;
        int-gpios = <&gpio0 3 GPIO_ACTIVE_HIGH>;

        expander_gpio: gpio {
            compatible = "fri3d,badge-2026-expander-gpio";
            gpio-controller;
            #gpio-cells = <2>;
            ngpios = <5>;
        };

        keys {
            compatible = "fri3d,badge-2026-expander-keys";

            button_a {
                bit-num = <4>;
                zephyr,code = <INPUT_KEY_A>;
            };
        };

        leds {
            compatible = "fri3d,badge-2026-expander-led";
        };

        battery {
            compatible = "fri3d,badge-2026-expander-sensor";
        };

        charger {
            compatible = "fri3d,badge-2026-expander-charger";
        };
    };

compatible: "fri3d,badge-2026-expander"

include: i2c-device.yaml

properties:
  int-gpios:
    type: phandle-array
    description: |
      GPIO connected to the coprocessor INT output (CH32 PC17). The
      coprocessor drives it high for about 50 ms when an input changes, so
      it is active-high.

  rvswd:
    type: phandle
    description: |
      RVSWD interface (wch,rvswd) on the coprocessor's I2C pins, to update its
      firmware (CONFIG_MFD_FRI3D_EXPANDER_UPDATE).

  boot-timeout-ms:
    type: int
    default: 1500
    description: |
      Time to wait for the coprocessor to answer on I2C at init. After a
      power-on the coprocessor firmware waits one second before it enables
      its I2C slave.
```

## zephyr/dts/bindings/sensor/fri3d,badge-2026-expander-sensor.yaml
```yaml
# Copyright (c) 2026 Bert Outtier <outtierbert@gmail.com>
# SPDX-License-Identifier: Apache-2.0

description: |
  Battery voltage measured by the Fri3d Badge 2026 I/O coprocessor (CH32X035,
  100k/100k divider on PC0), exposed through the sensor API as
  SENSOR_CHAN_VOLTAGE. Can be used as the source of a
  zephyr,fuel-gauge-composite.

compatible: "fri3d,badge-2026-expander-sensor"

include: base.yaml
```
